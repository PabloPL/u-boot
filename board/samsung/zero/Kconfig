## board/samsung/zero/Kconfig
```kconfig
if TARGET_ZERO

config SYS_BOARD
	default "zero"
	help
	  Samsung zero is a mobile phone using Exynos7420 SoC.
	  It's also called Samsung Galaxy S6/S6 Edge.

config SYS_VENDOR
	default "samsung"

config SYS_CONFIG_NAME
	default "zero"

endif
```

## configs/zero_defconfig
```kconfig
CONFIG_ARM=y
CONFIG_ARCH_CPU_INIT=y
CONFIG_ARCH_EXYNOS=y
CONFIG_SYS_TEXT_BASE=0x40205000
CONFIG_ARCH_EXYNOS7=y
CONFIG_TARGET_ZERO=y
CONFIG_SYS_MALLOC_F_LEN=0x2000
CONFIG_NR_DRAM_BANKS=8
CONFIG_IDENT_STRING=" for zero"
CONFIG_CONSOLE_MUX=y
# CONFIG_DISPLAY_CPUINFO is not set
# CONFIG_CMDLINE_EDITING is not set
# CONFIG_AUTO_COMPLETE is not set
CONFIG_SYS_PROMPT="Samsung S6/S6 edge # "
# CONFIG_AUTOBOOT is not set
CONFIG_CMD_CLK=y
CONFIG_CMD_I2C=y
# CONFIG_CMD_SETEXPR is not set
CONFIG_DEFAULT_DEVICE_TREE="exynos7420-zero"
CONFIG_CLK_CCF=y
CONFIG_SYS_I2C_EXYNOS_HS=y
# CONFIG_MMC is not set
```
